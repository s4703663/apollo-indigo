## CMakeLists.txt
```
cmake_minimum_required(VERSION 3.20.0)
find_package(Zephyr REQUIRED HINTS $ENV{ZEPHYR_BASE})
project(display)

target_sources(app PRIVATE
    src/main.c
    src/mqtt_messenger.c
    src/screen_display.c
    src/message_handler.c
    src/synchronisation.c
    src/distance.c
    src/orientation.c
)
```

## Kconfig
```
mainmenu "Display Node Configuration"

if WIFI
config WIFI_SSID
	string "WIFI SSID - Network name"
	help
          SSID of Wifi network to connect to.
config WIFI_PSK
	string "WIFI PSK - Network password key"
	help
          Password for Wifi network to connect to.
endif

config MQTT_BROKER_ADDRESS
    string "IPv4 address for MQTT broker"
    help
       IPv4 address for MQTT broker

config MQTT_CLIENT_ID
    string "MQTT client ID"
    help
       Name of MQTT client.

config DISPLAY_DEVICE_NUMBER
    int "Which display device is this"
    help
      The display number starts from 1 in the top left, 2 in the top middle,
      3 in the top right, etc. until 9 in the bottom right.

config DISPLAY_DEVICE_REVERSED_NUMBER
    int "Which display number is diagonally opposite"
    help
      The diagonally opposite display number is used for when the display's
      orientation becomes flipped.

source "Kconfig.zephyr"
```

## prj.conf
```kconfig
CONFIG_HEAP_MEM_POOL_SIZE=16384
CONFIG_MAIN_STACK_SIZE=2048
# CONFIG_MAIN_STACK_SIZE=4096
CONFIG_LOG=y
CONFIG_DISPLAY=y
# CONFIG_LV_COLOR_DEPTH_32=y

CONFIG_ESP_SPIRAM=y
# 8MB
# CONFIG_ESP_SPIRAM_SIZE=8388608
CONFIG_ESP32_WIFI_NET_ALLOC_SPIRAM=n
CONFIG_SPIRAM_TYPE_ESPPSRAM64=y
# CONFIG_SPIRAM_MODE_QUAD=y
# 2MB
# CONFIG_ESP_SPIRAM_HEAP_SIZE=2097152
# CONFIG_ESP_SPIRAM_HEAP_SIZE=8000000
CONFIG_ESP_SPIRAM_HEAP_SIZE=4194304
# CONFIG_ESP_SPIRAM_HEAP_SIZE=65536
CONFIG_ESP_HEAP_MIN_EXTRAM_THRESHOLD=2048
# CONFIG_ESP_HEAP_SEARCH_ALL_REGIONS=y
# CONFIG_HEAP_MEM_POOL_SIZE=2097152
# CONFIG_HEAP_MEM_POOL_SIZE=65536
# ARCH_HAS_USERSPACE=y
# SRAM_REGION_PERMISSIONS=y
# CONFIG_USERSPACE=y
CONFIG_SYS_HEAP_BIG_ONLY=y
# CONFIG_SPIRAM_SPEED_80M=y


CONFIG_NETWORKING=y
CONFIG_NET_SOCKETS=y
CONFIG_NET_TCP=y
# Disable IPv6 support
CONFIG_NET_IPV6=n
# Enable IPv4 support
CONFIG_NET_IPV4=y
# Enable the MQTT Lib
CONFIG_MQTT_LIB=y
# For IPv6
# CONFIG_NET_BUF_DATA_SIZE=256
CONFIG_NET_BUF_DATA_SIZE=512
# useful for debugging:
CONFIG_NET_SHELL=y

# Not sure what these are needed for:
CONFIG_ENTROPY_GENERATOR=y
CONFIG_TEST_RANDOM_GENERATOR=y

CONFIG_WIFI=y
CONFIG_NET_L2_ETHERNET=y
# Useful for debugging:
CONFIG_NET_LOG=y

CONFIG_NET_DHCPV4=y
CONFIG_ESP32_WIFI_STA_AUTO_DHCPV4=y

CONFIG_NET_L2_WIFI_MGMT=y

# CONFIG_WIFI_SSID="Mike's Iphone"
# CONFIG_WIFI_PSK="mikejones"
# CONFIG_WIFI_SSID="Apollo-Indigo"
# CONFIG_WIFI_PSK="mikejones"
CONFIG_WIFI_SSID="TP-Link_19FA"
CONFIG_WIFI_PSK="77202468"

# For Mike's Iphone hotspot
# CONFIG_MQTT_BROKER_ADDRESS="172.20.10.14"
# for laptop hotspot
# CONFIG_MQTT_BROKER_ADDRESS="192.168.137.1"
# for wifi router
CONFIG_MQTT_BROKER_ADDRESS="192.168.0.100"
# CONFIG_MQTT_BROKER_ADDRESS="10.89.83.158"
# Set this in each display overlay
# CONFIG_MQTT_CLIENT_ID="DisplayNode"

# CONFIG_NET_BUF_DATA_SIZE

CONFIG_EVENTS=y
CONFIG_FPU=y
CONFIG_FPU_SHARING=y
CONFIG_MPU6050_TRIGGER_NONE=y
```

## overlay-display1.conf
```kconfig
CONFIG_DISPLAY_DEVICE_NUMBER=1
CONFIG_DISPLAY_DEVICE_REVERSED_NUMBER=9
CONFIG_MQTT_CLIENT_ID="MJSL-DisplayNode1"

CONFIG_SENSOR=y
CONFIG_SENSOR_LOG_LEVEL_DBG=y
```

## overlay-display2.conf
```kconfig
CONFIG_DISPLAY_DEVICE_NUMBER=2
CONFIG_DISPLAY_DEVICE_REVERSED_NUMBER=8
CONFIG_MQTT_CLIENT_ID="MJSL-DisplayNode2"
```

## overlay-display3.conf
```kconfig
CONFIG_DISPLAY_DEVICE_NUMBER=3
CONFIG_DISPLAY_DEVICE_REVERSED_NUMBER=7
CONFIG_MQTT_CLIENT_ID="MJSL-DisplayNode3"
```

## overlay-display4.conf
```kconfig
CONFIG_DISPLAY_DEVICE_NUMBER=4
CONFIG_DISPLAY_DEVICE_REVERSED_NUMBER=6
CONFIG_MQTT_CLIENT_ID="MJSL-DisplayNode4"
```

## overlay-display5.conf
```kconfig
CONFIG_DISPLAY_DEVICE_NUMBER=5
CONFIG_DISPLAY_DEVICE_REVERSED_NUMBER=5
CONFIG_MQTT_CLIENT_ID="MJSL-DisplayNode5"
```

## overlay-display6.conf
```kconfig
CONFIG_DISPLAY_DEVICE_NUMBER=6
CONFIG_DISPLAY_DEVICE_REVERSED_NUMBER=4
CONFIG_MQTT_CLIENT_ID="MJSL-DisplayNode6"
```

## boards/m5stack_core2.overlay
```dts
&wifi {
	status = "okay";
};

&psram0 {
	status = "okay";
};

/ {
    us0: hc-sr04 {
        compatible = "elecfreaks,hc-sr04";
        trig-gpios = <&gpio1 1 GPIO_ACTIVE_HIGH>;
        echo-gpios = <&gpio1 0 GPIO_ACTIVE_HIGH>;
        status = "okay";
    };
};
```

## src/display_mode.h
```c
#ifndef DISPLAY_MODE_H
#define DISPLAY_MODE_H

#define DISPLAY_WIDTH 320
#define DISPLAY_HEIGHT 240
#define BYTES_PER_PIXEL 3
#define DISPLAY_TOTAL_PIXELS (DISPLAY_WIDTH * DISPLAY_HEIGHT)
#define DISPLAY_TOTAL_BYTES (DISPLAY_TOTAL_PIXELS * BYTES_PER_PIXEL)
#define DISPLAY_BYTES_PER_ROW (DISPLAY_WIDTH * BYTES_PER_PIXEL)

enum DisplayMode {
    DISPLAY_MODE_OFF = 0,
    DISPLAY_MODE_IMAGE = 1,
    DISPLAY_MODE_ANIMATION = 2,
    DISPLAY_MODE_DISTANCE = 3
};

#endif
```

## src/distance.c
```c
#include <zephyr/kernel.h>
#include <zephyr/drivers/sensor.h>
#include "distance.h"
#include "message_handler.h"

#ifdef CONFIG_SENSOR

#include <zephyr/logging/log.h>
LOG_MODULE_REGISTER(distance, LOG_LEVEL_DBG);

const struct device *sensor = DEVICE_DT_GET(DT_NODELABEL(us0));

static void distance_thread(void *, void *, void *);

K_THREAD_DEFINE(distance_tid, DISTANCE_THREAD_STACK_SIZE, distance_thread, NULL, NULL, NULL,
        DISTANCE_THREAD_PRIORITY, K_FP_REGS, 0);

int distance_init(void)
{
    if (!device_is_ready(sensor)) {
        LOG_ERR("Sensor not ready");
        return 1;
    }

    return 0;
}

float distance_get(void)
{
    int ret;
    struct sensor_value val;

    ret = sensor_sample_fetch(sensor);
    if (ret < 0) {
        LOG_ERR("Could not fetch sample (%d)", ret);
        return 1;
    }
    ret = sensor_channel_get(sensor, SENSOR_CHAN_DISTANCE, &val);
    if (ret < 0) {
        LOG_ERR("Could not get sample (%d)", ret);
        return 0;
    }
    float distance = sensor_value_to_float(&val);

    return distance;
}

// Defined in main.c
extern volatile enum DisplayMode current_display_mode;

static void distance_thread(void *, void *, void *)
{
    k_thread_suspend(distance_tid);

    int ret = distance_init();
    if (ret != 0) {
        return;
    }

    struct Msg msg;
    msg.topic = MQTT_MSG_DIST_TOPIC;

    for (;;) {
        float distance = distance_get();
        msg.data.dist_topic_data.distance = distance;
        if (current_display_mode == DISPLAY_MODE_DISTANCE) {
            message_handler_send(&msg);
        }
        // printk("%f\n", distance);
        k_msleep(500);
    }
}
#endif
```

## src/distance.h
```c
#ifndef DISTANCE_H
#define DISTANCE_H

#ifdef CONFIG_SENSOR

#define DISTANCE_THREAD_STACK_SIZE 2048
// Important that this has a higher priority than other threads
// Since the timing of the hc-sr04 driver depends on k_sleep()
#define DISTANCE_THREAD_PRIORITY 4

extern const k_tid_t distance_tid;

int distance_init(void);

float distance_get(void);

#endif

#endif
```

## src/message_handler.c
```c
#include <string.h>
#include <stdlib.h>
#include <zephyr/kernel.h>
#include "message_handler.h"

#include <zephyr/logging/log.h>
LOG_MODULE_REGISTER(message_handler, LOG_LEVEL_DBG);

const char *const topics[] = {
    [MQTT_MSG_MODE_TOPIC] = MODE_TOPIC,
    [MQTT_MSG_HEARBEAT_TOPIC] = HEARTBEAT_TOPIC,
    [MQTT_MSG_IMG_TOPIC] = IMG_TOPIC,
    [MQTT_MSG_ANIM_TOPIC] = ANIM_TOPIC,
    [MQTT_MSG_DIST_TOPIC] = DIST_TOPIC,
    [MQTT_MSG_ORIENT_TOPIC] = ORIENT_TOPIC,
    [MQTT_MSG_REVERSE_IMG_TOPIC] = REVERSE_IMG_TOPIC,
    [MQTT_MSG_REVERSE_ANIM_TOPIC] = REVERSE_ANIM_TOPIC
};
size_t topics_count = sizeof(topics) / sizeof(topics[0]);

static enum MQTTTopic decode_mqtt_topic(const char *topic)
{
    switch (topic[0]) {
    case 'm':
        if (strcmp(topic + 1, topics[MQTT_MSG_MODE_TOPIC] + 1) == 0) {
            return MQTT_MSG_MODE_TOPIC;
        }
        return MQTT_MSG_INVALID;
    case 'h':
        if (strcmp(topic + 1, topics[MQTT_MSG_HEARBEAT_TOPIC] + 1) == 0) {
            return MQTT_MSG_HEARBEAT_TOPIC;
        }
        return MQTT_MSG_INVALID;
    case 'i':
        if (strcmp(topic + 1, topics[MQTT_MSG_IMG_TOPIC] + 1) == 0) {
            return MQTT_MSG_IMG_TOPIC;
        } else if (strcmp(topic + 1, topics[MQTT_MSG_REVERSE_IMG_TOPIC] + 1) == 0) {
            return MQTT_MSG_REVERSE_IMG_TOPIC;
        }
        return MQTT_MSG_INVALID;
    case 'a':
        if (strcmp(topic + 1, topics[MQTT_MSG_ANIM_TOPIC] + 1) == 0) {
            return MQTT_MSG_ANIM_TOPIC;
        } else if (strcmp(topic + 1, topics[MQTT_MSG_REVERSE_ANIM_TOPIC] + 1) == 0) {
            return MQTT_MSG_REVERSE_ANIM_TOPIC;
        }
        return MQTT_MSG_INVALID;
    case 'd':
        if (strcmp(topic + 1, topics[MQTT_MSG_DIST_TOPIC] + 1) == 0) {
            return MQTT_MSG_DIST_TOPIC;
        }
        return MQTT_MSG_INVALID;
    case 'o':
        if (strcmp(topic + 1, topics[MQTT_MSG_ORIENT_TOPIC] + 1) == 0) {
            return MQTT_MSG_ORIENT_TOPIC;
        }
        return MQTT_MSG_INVALID;
    default:
        return MQTT_MSG_INVALID;
    }
}

int message_handler_init(void)
{
    int ret;

    ret = mqtt_messenger_init();
    if (ret != 0) {
        return ret;
    }

    ret = mqtt_messenger_subscribe(topics, topics_count);

    return ret;
}

#define HELPER_BUF_SIZE 32

int message_handler_receive(struct Msg *msg, k_timeout_t timeout)
{
    int ret = 0;
    struct Message message;
    static char helper_buf[HELPER_BUF_SIZE];

    ret = mqtt_messenger_receive(&message, timeout);
    if (ret != 0) {
        return ret;
    }

    msg->topic = decode_mqtt_topic(message.topic);

    uint32_t data;
    uint8_t *p = message.buffer;

    switch (msg->topic) {
    case MQTT_MSG_MODE_TOPIC:
        printk("extracting MODE\n");
        memcpy(helper_buf, message.buffer, message.size);
        helper_buf[message.size] = '\0';
        data = strtoul(helper_buf, NULL, 10);
        if (data > DISPLAY_MODE_DISTANCE) {
            LOG_ERR("Received invalid display mode: %d", data);
            goto error_exit;
        }
        msg->data.mode_topic_data.display_mode = data;
        printk("finished extracting MODE\n");
        goto common_exit;
    case MQTT_MSG_HEARBEAT_TOPIC:
        // data = p[0] << 24 | p[1] << 16 | p[2] << 8 | p[3] << 0;
        memcpy(helper_buf, message.buffer, message.size);
        helper_buf[message.size] = '\0';
        data = strtoul(helper_buf, NULL, 10);
        msg->data.heartbeat_topic_data.tick_num = data;
        goto common_exit;
    case MQTT_MSG_IMG_TOPIC:
    case MQTT_MSG_REVERSE_IMG_TOPIC:
        msg->data.image_topic_data.buffer = message.buffer;
        goto img_exit;
    case MQTT_MSG_ANIM_TOPIC:
    case MQTT_MSG_REVERSE_ANIM_TOPIC:
        msg->data.anim_topic_data.frame_num = *p;
        msg->data.anim_topic_data.buffer = p + 1;
        goto img_exit;
    case MQTT_MSG_DIST_TOPIC:
        if (message.size > HELPER_BUF_SIZE) {
            LOG_ERR("Distance value is too big");
            goto error_exit;
        }
        memcpy(helper_buf, message.buffer, message.size);
        helper_buf[message.size] = '\0';
        msg->data.dist_topic_data.distance = strtof(helper_buf, NULL);
        goto common_exit;
    case MQTT_MSG_ORIENT_TOPIC:
        if (p[0] == '1') {
            msg->data.orient_topic_data.orientation = ORIENTATION_DOWN;
        } else {
            msg->data.orient_topic_data.orientation = ORIENTATION_UP;
        }
        goto common_exit;
    default:
        // break;
        LOG_ERR("Received MQTT message with unknown topic: %s", message.topic);
        goto error_exit;
    }

error_exit:
    msg->topic = MQTT_MSG_INVALID;
    ret = 1;
common_exit:
    k_free(message.buffer);
img_exit:
    k_free(message.topic);

    return ret;
}

int message_handler_send(const struct Msg *msg)
{
    int ret;
    struct Message message;
    static char buf[16];

    switch (msg->topic) {
    case MQTT_MSG_DIST_TOPIC:
        snprintk(buf, 16, "%f", (double) msg->data.dist_topic_data.distance);
        message.topic = DIST_TOPIC;
        message.size = strlen(buf);
        break;
    case MQTT_MSG_ORIENT_TOPIC:
        if (msg->data.orient_topic_data.orientation == ORIENTATION_DOWN) {
            buf[0] = '1';
        } else {
            buf[0] = '0';
        }
        message.topic = ORIENT_TOPIC;
        message.size = 1;
        break;
    default:
        LOG_ERR("Only support sending distance and orientation messages");
        return 1;
    }

    message.buffer = buf;

    return mqtt_messenger_send(&message);

    // message.topic = topics[msg->topic];

    // switch (msg->topic) {
    // case MQTT_MSG_MODE_TOPIC:
    //     buf[0] = msg->data.mode_topic_data.display_mode;
    //     message.buffer = buf;
    //     message.size = 1;
    //     break;
    // // case MQTT_MSG_HEARBEAT_TOPIC:
    // //     // never gonna use this
    // //     return 1;
    // default:
    //     return 1;
    // }

    // return 1;
}
```

## src/message_handler.h
```c
#ifndef MESSAGE_HANDLER_H
#define MESSAGE_HANDLER_H

#include "mqtt_messenger.h"
#include "display_mode.h"
#include "orientation_enum.h"

#define STR2(s) #s
#define STR(s) STR2(s)

#define MODE_TOPIC "mode"
#define HEARTBEAT_TOPIC "heartbeat"
#define IMG_TOPIC "img" STR(CONFIG_DISPLAY_DEVICE_NUMBER)
#define ANIM_TOPIC "anim" STR(CONFIG_DISPLAY_DEVICE_NUMBER)
#define DIST_TOPIC "distance"
#define ORIENT_TOPIC "orientation"
#define REVERSE_IMG_TOPIC "img" STR(CONFIG_DISPLAY_DEVICE_REVERSED_NUMBER)
#define REVERSE_ANIM_TOPIC "anim" STR(CONFIG_DISPLAY_DEVICE_REVERSED_NUMBER)

enum MQTTTopic {
    MQTT_MSG_MODE_TOPIC,
    MQTT_MSG_HEARBEAT_TOPIC,
    MQTT_MSG_IMG_TOPIC,
    MQTT_MSG_ANIM_TOPIC,
    MQTT_MSG_DIST_TOPIC,
    MQTT_MSG_ORIENT_TOPIC,
    MQTT_MSG_REVERSE_IMG_TOPIC,
    MQTT_MSG_REVERSE_ANIM_TOPIC,
    MQTT_MSG_INVALID
};

struct ModeTopicData {
    enum DisplayMode display_mode;
};

struct HeartbeatTopicData {
    uint32_t tick_num;
};

struct ImageTopicData {
    const void *buffer;
};

struct AnimTopicData {
    int frame_num;
    const void *buffer;
};

struct DistTopicData {
    float distance;
};

struct OrientTopicData {
    enum Orientation orientation;
};

union MsgData {
    struct ModeTopicData mode_topic_data;
    struct HeartbeatTopicData heartbeat_topic_data;
    struct ImageTopicData image_topic_data;
    struct AnimTopicData anim_topic_data;
    struct DistTopicData dist_topic_data;
    struct OrientTopicData orient_topic_data;
};

struct Msg {
    enum MQTTTopic topic;
    union MsgData data;
};

int message_handler_init(void);

int message_handler_receive(struct Msg *msg, k_timeout_t timeout);

int message_handler_send(const struct Msg *msg);

#endif
```

## src/mqtt_messenger.c
```c
#include <stdalign.h>
#include <zephyr/kernel.h>
#include <zephyr/net/socket.h>
#include <zephyr/net/mqtt.h>
#include <zephyr/random/random.h>
#include <zephyr/net/wifi_mgmt.h>

#include <zephyr/logging/log.h>
LOG_MODULE_REGISTER(mqtt_messenger, LOG_LEVEL_DBG);

#include "mqtt_messenger.h"

#define SERVER_PORT 1883
#define MQTT_TX_BUFFER_SIZE 128
// #define MQTT_RX_BUFFER_SIZE 262114 // 256 KB
// #define MQTT_RX_BUFFER_SIZE 128 // 256 KB
#define MQTT_RX_BUFFER_SIZE 16384 // 256 KB
#define APP_CONNECT_TIMEOUT_MS 2000
#define APP_SLEEP_MSECS 500

#define HEARTBEAT_THREAD_STACK_SIZE 2048
#define HEARTBEAT_THREAD_PRIORITY 4
#define HEARTBEAT_SLEEP_SEC 15

#define RECEIVE_THREAD_STACK_SIZE 2048
#define RECEIVE_THREAD_PRIORITY 5
#define RECEIVE_POLL_TIMEOUT_MS 1000


#define RC_STR(rc) ((rc) == 0 ? "OK" : "ERROR")
#define PRINT_RESULT(func, rc) LOG_INF("%s: %d <%s>", (func), rc, RC_STR(rc))

// The mqtt client struct
static struct mqtt_client client;

// MQTT broker details
static struct sockaddr_storage broker;

// Buffers for MQTT client
// static uint8_t rx_buffer[APP_MQTT_BUFFER_SIZE];
// static uint8_t tx_buffer[APP_MQTT_BUFFER_SIZE];
static uint8_t rx_buffer[MQTT_RX_BUFFER_SIZE];
static uint8_t tx_buffer[MQTT_TX_BUFFER_SIZE];

// static uint8_t *rx_buffer = NULL;
// static uint8_t *tx_buffer = NULL;

// Buffer for application:
// static char payload_buffer[APP_MQTT_BUFFER_SIZE];

static volatile bool connected;

static struct zsock_pollfd fds[1] = {};
static int nfds = 0;

// For wifi connection callback
struct net_mgmt_event_callback wifi_cb;

// Periodically send MQTT heartbeat
static void mqtt_heartbeat_thread(void *, void *, void *);
static void mqtt_receive_thread(void *, void *, void *);

K_THREAD_DEFINE(mqtt_heartbeat_tid, HEARTBEAT_THREAD_STACK_SIZE, mqtt_heartbeat_thread, NULL, NULL, NULL,
        HEARTBEAT_THREAD_PRIORITY, 0, 0);

K_THREAD_DEFINE(mqtt_receive_tid, RECEIVE_THREAD_STACK_SIZE, mqtt_receive_thread, NULL, NULL, NULL,
        RECEIVE_THREAD_PRIORITY, 0, 0);

// Queue for incoming messages
K_MSGQ_DEFINE(receive_msgq, sizeof(struct Message), 4, alignof(struct Message));
// Queue for outgoing messages
K_MSGQ_DEFINE(send_msgq, sizeof(struct Message), 4, alignof(struct Message));

K_SEM_DEFINE(connected_sem, 0, 1);

// static int wait(int timeout)
// {
//     int ret = 0;

//     if (nfds > 0) {
//         ret = zsock_poll(fds, nfds, timeout);
//         if (ret < 0) {
//             LOG_ERR("poll error: %d", errno);
//         }
//     }

//     return ret;
// }

static void mqtt_heartbeat_thread(void *, void *, void *)
{
    int ret;

    for (;;) {
        if (connected) {
            ret = mqtt_live(&client);
            if (ret != 0 && ret != -EAGAIN) {
                PRINT_RESULT("mqtt_live", ret);
                // return ret;
            }
        }
        k_sleep(K_SECONDS(HEARTBEAT_SLEEP_SEC));
    }
}

static void mqtt_receive_thread(void *, void *, void *)
{
    int ret;
    
    for (;;) {
        if (connected) {
            // negative timeout means wait forever
            // Returns -1 on error, or no. of events occurred
            ret = zsock_poll(fds, nfds, RECEIVE_POLL_TIMEOUT_MS);
            if (ret < 0) {
                LOG_ERR("poll error: %d", errno);
                // return ret;
            // } else if (ret == 0) {
            //     continue;
            }
            ret = mqtt_input(&client);
            if (ret != 0) {
                PRINT_RESULT("mqtt_input", ret);
                // return ret;
            }
            // ret = mqtt_input(&client);
            // if (ret != 0) {
            //     PRINT_RESULT("mqtt_input", ret);
            //     // return ret;
            // }
            // k_msleep(10);
        } else {
            k_msleep(RECEIVE_POLL_TIMEOUT_MS);
        }
    }
}

static void prepare_fds(void)
{
    fds[0].fd = client.transport.tcp.sock;
    fds[0].events = ZSOCK_POLLIN;
    nfds = 1;
}

static void clear_fds(void)
{
    nfds = 0;
}

static void mqtt_evt_handler(struct mqtt_client *const client, const struct mqtt_evt *evt)
{
    int err;

    switch (evt->type) {
    case MQTT_EVT_CONNACK:
        if (evt->result != 0) {
            LOG_ERR("MQTT connect failed %d", evt->result);
            break;
        }

        connected = true;
        LOG_INF("MQTT client connected!");
        k_sem_give(&connected_sem);

        break;

    case MQTT_EVT_DISCONNECT:
        LOG_INF("MQTT client disconnected %d", evt->result);

        connected = false;
        clear_fds();

        break;

    case MQTT_EVT_PUBLISH:
        if (evt->result != 0) {
            LOG_ERR("MQTT PUBLISH error %d", evt->result);
            break;
        }

        // printk("Inside MQTT_EVT_PUBLISH\n");

        // LOG_INF("PUBLISH packet id: %u", evt->param.publish.message_id);

        // evt->param.publish.message.payload.len
        size_t topic_size = evt->param.publish.message.topic.topic.size;
        size_t payload_size = evt->param.publish.message.payload.len;
        // printk("PUBLISH payload length: %u\n", payload_size);
        
        struct Message message = {
            .topic = k_malloc(topic_size + 1),
            .buffer = k_malloc(payload_size),
            .size = payload_size
        };

        if (message.topic == NULL || message.buffer == NULL) {
            LOG_ERR("Failed to allocate enough memory for published message");
            k_free(message.topic);
            k_free(message.buffer);
            break;
        }

        memcpy(message.topic, evt->param.publish.message.topic.topic.utf8, topic_size);
        message.topic[topic_size] = '\0';

        LOG_INF("PUBLISH packet id: %u, payload length: %u, topic: %s", evt->param.publish.message_id,
                payload_size, message.topic);
        // printk("Before readall\n");
        err = mqtt_readall_publish_payload(client, message.buffer, payload_size);
        if (err < 0) {
            LOG_ERR("Failed to read publish payload: %d", err);
        }
        // printk("After readall\n");

        // LOG_INF("PUBLISH payload read length: %u", err);
        // printk("PUBLISH payload read length: %u\n", err);

        if (evt->param.publish.message.topic.qos == MQTT_QOS_1_AT_LEAST_ONCE) {
            struct mqtt_puback_param puback_param = {
                .message_id = evt->param.publish.message_id
            };
            err = mqtt_publish_qos1_ack(client, &puback_param);
            if (err != 0) {
                LOG_ERR("Failed to send MQTT PUBACK: %d", err);
            }
        } else if (evt->param.publish.message.topic.qos == MQTT_QOS_2_EXACTLY_ONCE) {
            struct mqtt_pubrec_param pubrec_param = {
                .message_id = evt->param.publish.message_id
            };
            err = mqtt_publish_qos2_receive(client, &pubrec_param);
            if (err != 0) {
                LOG_ERR("Failed to send MQTT PUBREC: %d", err);
            }
        }

        // printk("Before msgq_put\n");
        err = k_msgq_put(&receive_msgq, &message, K_NO_WAIT);
        if (err != 0) {
            k_free(message.topic);
            k_free(message.buffer);
            LOG_ERR("Failed to add received MQTT message to queue");
            break;
        }
        // printk("After msgq_put\n");
        
        // LOG_INF("Received message from topic %s:\n%s\n", evt->param.publish.message.topic.topic.utf8,
        //         payload_buffer);
        
        break;

    case MQTT_EVT_PUBACK:
        if (evt->result != 0) {
            LOG_ERR("MQTT PUBACK error %d", evt->result);
            break;
        }

        LOG_INF("PUBACK packet id: %u", evt->param.puback.message_id);

        break;

    case MQTT_EVT_PUBREC:
        if (evt->result != 0) {
            LOG_ERR("MQTT PUBREC error %d", evt->result);
            break;
        }

        LOG_INF("PUBREC packet id: %u", evt->param.pubrec.message_id);

        const struct mqtt_pubrel_param rel_param = {
            .message_id = evt->param.pubrec.message_id
        };

        err = mqtt_publish_qos2_release(client, &rel_param);
        if (err != 0) {
            LOG_ERR("Failed to send MQTT PUBREL: %d", err);
        }

        break;

    case MQTT_EVT_PUBREL:
        if (evt->result != 0) {
            LOG_ERR("MQTT PUBREL error %d", evt->result);
            break;
        }

        LOG_INF("PUBREL packet id: %u", evt->param.pubrel.message_id);

        const struct mqtt_pubcomp_param comp_param = {
            .message_id = evt->param.pubrel.message_id
        };

        err = mqtt_publish_qos2_complete(client, &comp_param);
        if (err != 0) {
            LOG_ERR("Failed to send MQTT PUBCOMP: %d", err);
        }

        break;

    case MQTT_EVT_PUBCOMP:
        if (evt->result != 0) {
            LOG_ERR("MQTT PUBCOMP error %d", evt->result);
            break;
        }

        LOG_INF("PUBCOMP packet id: %u",
            evt->param.pubcomp.message_id);

        break;

    case MQTT_EVT_SUBACK:
        if (evt->result != 0) {
            LOG_ERR("MQTT SUBACK error %d", evt->result);
            break;
        }

        LOG_INF("SUBACK packet id: %u", evt->param.suback.message_id);

        break;

    case MQTT_EVT_UNSUBACK:
        if (evt->result != 0) {
            LOG_ERR("MQTT UNSUBACK error %d", evt->result);
            break;
        }

        LOG_INF("UNSUBACK packet id: %u", evt->param.unsuback.message_id);

        break;

    case MQTT_EVT_PINGRESP:
        LOG_INF("PINGRESP packet");
        break;

    default:
        break;
    }
}

static int broker_init(void)
{
    int ret;

    struct sockaddr_in *broker4 = (struct sockaddr_in *) &broker;

    broker4->sin_family = AF_INET;
    broker4->sin_port = htons(SERVER_PORT);
    // returns 1 on success
    ret = zsock_inet_pton(AF_INET, CONFIG_MQTT_BROKER_ADDRESS, &broker4->sin_addr);
    if (ret != 1) {
        LOG_ERR("Failed to process MQTT broker address: \"%s\"", CONFIG_MQTT_BROKER_ADDRESS);
        return ret;
    }

    return 0;
}

static int client_init(void)
{
    int ret;

    mqtt_client_init(&client);
    ret = broker_init();
    if (ret) {
        return ret;
    }

    // MQTT client configuration
    client.broker = &broker;
    client.evt_cb = mqtt_evt_handler;
    client.client_id.utf8 = (uint8_t *) CONFIG_MQTT_CLIENT_ID;
    client.client_id.size = strlen(CONFIG_MQTT_CLIENT_ID);
    client.password = NULL;
    client.user_name = NULL;
    client.protocol_version = MQTT_VERSION_3_1_1;

    // MQTT buffers configuration
    client.rx_buf = rx_buffer;
    client.rx_buf_size = MQTT_RX_BUFFER_SIZE; // sizeof(rx_buffer);
    client.tx_buf = tx_buffer;
    client.tx_buf_size = MQTT_TX_BUFFER_SIZE; // sizeof(tx_buffer);

    client.transport.type = MQTT_TRANSPORT_NON_SECURE;

    return 0;
}

static int wait(int timeout)
{
    int ret = 0;

    if (nfds > 0) {
        ret = zsock_poll(fds, nfds, timeout);
        if (ret < 0) {
            LOG_ERR("poll error: %d", errno);
        }
    }

    return ret;
}

static int start_mqtt(void)
{
    int ret;

    do {
        ret = client_init();
        if (ret) {
            return ret;
        }
        ret = mqtt_connect(&client);
        if (ret) {
            PRINT_RESULT("mqtt_connect", ret);
            k_msleep(APP_SLEEP_MSECS);
            continue;
        }

        prepare_fds();

        if (wait(APP_CONNECT_TIMEOUT_MS)) {
            mqtt_input(&client);
        }

        if (!connected) {
            mqtt_abort(&client);
        }

    } while (!connected);

    return 0;
}

static void wifi_connect_cb(struct net_mgmt_event_callback *cb, uint32_t mgmt_event, struct net_if *iface)
{
    printk("Inside callback\n");
    if (mgmt_event != NET_EVENT_IPV4_ADDR_ADD) {
    // if (mgmt_event != NET_EVENT_L4_CONNECTED) {
        return;
    }
    // WiFi connected, initialize MQTT client here
    LOG_INF("Wifi connected");
    start_mqtt();
}

int mqtt_messenger_init(void)
{
    // rx_buffer = k_malloc(MQTT_RX_BUFFER_SIZE);
    // if (rx_buffer == NULL) {
    //     LOG_ERR("Failed to allocate enough space for RX buffer for MQTT");
    //     return 1;
    // }
    // tx_buffer = k_malloc(MQTT_TX_BUFFER_SIZE);
    // if (tx_buffer == NULL) {
    //     LOG_ERR("Failed to allocate enough space for TX buffer for MQTT");
    //     return 1;
    // }
    // Connect to WiFi
    struct net_if *iface = net_if_get_default();
    struct wifi_connect_req_params params = {
        .security = WIFI_SECURITY_TYPE_PSK,
        .ssid = CONFIG_WIFI_SSID,
        .ssid_length = strlen(CONFIG_WIFI_SSID),
        .psk = CONFIG_WIFI_PSK,
        .psk_length = strlen(CONFIG_WIFI_PSK)
    };
    while (1) {
        int ret = net_mgmt(NET_REQUEST_WIFI_CONNECT, iface, (void *)&params, sizeof(params));
        if (ret == 0) {
            break;
        }

        LOG_INF("Connect request failed %d. Waiting iface be up...", ret);
        k_msleep(500);
    }

    // net_mgmt_init_event_callback(&wifi_cb, wifi_connect_cb, NET_EVENT_L4_CONNECTED);
    net_mgmt_init_event_callback(&wifi_cb, wifi_connect_cb, NET_EVENT_IPV4_ADDR_ADD);
    // net_mgmt_init_event_callback(&wifi_cb, wifi_connect_cb, NET_EVENT_WIFI_CMD_CONNECT_RESULT);
    net_mgmt_add_event_callback(&wifi_cb);

    for (;;) {
        int ret = k_sem_take(&connected_sem, K_MSEC(2000));
        if (ret == 0) {
            break;
        }
        LOG_INF("MQTT Connecting...");
    }

    LOG_INF("MQTT Connected.");

    return 0;
}

int mqtt_messenger_subscribe(const char *const topics[], size_t topics_count)
{
    // // subscrite to topics here
    // struct mqtt_topic topic = {
    //     .topic = {
    //         .utf8 = "test_topic",
    //         .size = strlen("test_topic")
    //     },
    //     .qos = MQTT_QOS_2_EXACTLY_ONCE
    // };
    // struct mqtt_subscription_list subscription_list = {
    //     .list = &topic,
    //     .list_count = 1,
    //     .message_id = sys_rand32_get()
    // };
    // mqtt_subscribe(client, &subscription_list);

    struct mqtt_topic mqtt_topics[topics_count];

    for (size_t i = 0; i < topics_count; ++i) {
        mqtt_topics[i] = (struct mqtt_topic) {
            .topic = {
                .utf8 = (uint8_t *) topics[i], // no need to copy string
                .size = strlen(topics[i])
            },
            // .qos = MQTT_QOS_2_EXACTLY_ONCE
            .qos = MQTT_QOS_0_AT_MOST_ONCE
        };
    }
    struct mqtt_subscription_list subscription_list = {
        .list = mqtt_topics,
        .list_count = topics_count,
        .message_id = sys_rand32_get()
    };

    return mqtt_subscribe(&client, &subscription_list);
}

int mqtt_messenger_receive(struct Message *message, k_timeout_t timeout)
{
    return k_msgq_get(&receive_msgq, message, timeout);
}

int mqtt_messenger_send(const struct Message *message)
{
    // return k_msgq_put(&send_msgq, message, timeout);
    struct mqtt_publish_param param = {
        .message = {
            .topic = {
                // .qos = MQTT_QOS_2_EXACTLY_ONCE,
                .qos = MQTT_QOS_0_AT_MOST_ONCE,
                .topic = {
                    .utf8 = (uint8_t *) message->topic,
                    .size = strlen(message->topic)
                }
            },
            .payload = {
                .data = message->buffer,
                .len = message->size
            }
        },
        .message_id = sys_rand32_get(),
        .dup_flag = 0U,
        .retain_flag = 0U
    };

    return mqtt_publish(&client, &param);
    return 0;
}
```

## src/mqtt_messenger.h
```c
#ifndef MQTT_MESSENGER_H
#define MQTT_MESSENGER_H

struct Message {
    char *topic;
    void *buffer;
    size_t size;
};

int mqtt_messenger_init(void);

int mqtt_messenger_subscribe(const char *const topics[], size_t topics_count);

int mqtt_messenger_receive(struct Message *message, k_timeout_t timeout);

int mqtt_messenger_send(const struct Message *message);

#endif
```

## src/orientation.c
```c
#include <zephyr/kernel.h>
#include <zephyr/device.h>
#include <zephyr/drivers/sensor.h>
#include "orientation.h"
#include "message_handler.h"

#ifdef CONFIG_SENSOR

#include <zephyr/logging/log.h>
LOG_MODULE_REGISTER(orientation, LOG_LEVEL_DBG);

static enum Orientation orientation;

static const struct device *mpu6050 = DEVICE_DT_GET_ONE(invensense_mpu6050);

static void orientation_thread(void *, void *, void *);

K_THREAD_DEFINE(orientation_tid, ORIENTATION_THREAD_STACK_SIZE, orientation_thread, NULL, NULL, NULL,
        ORIENTATION_THREAD_PRIORITY, K_FP_REGS, 0);

int orientation_init(void)
{
    if (!device_is_ready(mpu6050)) {
        LOG_ERR("Accelerometer device %s not read\n", mpu6050->name);
        return 1;
    }

    orientation = ORIENTATION_UP;

    return 0;
}

enum Orientation orientation_get(void)
{
    int ret;
    struct sensor_value accel[3];

    ret = sensor_sample_fetch(mpu6050);

    if (ret != 0) {
        LOG_ERR("Failed to fetch sample for accelerometer");
        return ret;
    }

    ret = sensor_channel_get(mpu6050, SENSOR_CHAN_ACCEL_XYZ, accel);
    if (ret != 0) {
        LOG_ERR("Failed to get accelerometer channel data");
        return ret;
    }

    float y_accel = sensor_value_to_float(&accel[1]);

    // Provide a little bit of hysteresis
    switch (orientation) {
    case ORIENTATION_UP:
        if (y_accel < -4.f) {
            orientation = ORIENTATION_DOWN;
        }
        break;
    case ORIENTATION_DOWN:
        if (y_accel > 4.f) {
            orientation = ORIENTATION_UP;
        }
        break;
    }

    return orientation;
}

static void orientation_thread(void *, void *, void *)
{
    k_thread_suspend(orientation_tid);

    int ret = orientation_init();
    if (ret != 0) {
        return;
    }

    struct Msg msg;
    
    msg.topic = MQTT_MSG_ORIENT_TOPIC;

    for (;;) {
        enum Orientation orientation = orientation_get();
        msg.data.orient_topic_data.orientation = orientation;
        message_handler_send(&msg);
        k_msleep(500);
    }
}

#endif
```

## src/orientation.h
```c
#ifndef ORIENTATION_H
#define ORIENTATION_H

#ifdef CONFIG_SENSOR

#include "orientation_enum.h"

#define ORIENTATION_THREAD_STACK_SIZE 2048
#define ORIENTATION_THREAD_PRIORITY 5

extern const k_tid_t orientation_tid;

int orientation_init(void);

enum Orientation orientation_get(void);

#endif

#endif
```

## src/orientation_enum.h
```c
#ifndef ORIENTATION_ENUM_H
#define ORIENTATION_ENUM_H

enum Orientation {
    ORIENTATION_UP,
    ORIENTATION_DOWN
};

#endif
```

## src/screen_display.c
```c
#include <stdlib.h>
#include <zephyr/kernel.h>
#include <zephyr/device.h>
#include <zephyr/drivers/display.h>

#include <zephyr/logging/log.h>
LOG_MODULE_REGISTER(screen_display, LOG_LEVEL_INF);

#include "screen_display.h"
#include "synchronisation.h"
#include "images.h"

static const struct device *display_dev = DEVICE_DT_GET(DT_CHOSEN(zephyr_display));

// Not enough internal RAM to store the entire image to display
// -> instead, display it in segments of 1/3 at a time
#define DISPLAY_SEG_HEIGHT (DISPLAY_HEIGHT / 3)
#define DISPLAY_SEG_PIXELS (DISPLAY_WIDTH * DISPLAY_SEG_HEIGHT)
#define DISPLAY_SEG_BYTES (DISPLAY_SEG_PIXELS * BYTES_PER_PIXEL)

uint8_t buf[DISPLAY_SEG_HEIGHT][DISPLAY_BYTES_PER_ROW];

static volatile enum DisplayMode display_mode;
// static volatile int frame_num;
static enum Orientation display_orientation;

static const uint8_t *image_buffer = NULL;
static const uint8_t *anim_buffers[MAX_ANIMATION_FRAMES] = {0};
static const uint8_t *reverse_image_buffer = NULL;
static const uint8_t *reverse_anim_buffers[MAX_ANIMATION_FRAMES] = {0};

// static void screen_thread(void *, void *, void *);

// K_THREAD_DEFINE(screen_tid, SCREEN_THREAD_STACK_SIZE, screen_thread, NULL, NULL, NULL,
//         SCREEN_THREAD_PRIORITY, 0, 0);

int screen_display_init(void)
{
    struct display_capabilities capabilities;
    if (!device_is_ready(display_dev)) {
        LOG_ERR("Device %s not found. Aborting sample.", display_dev->name);
        return 0;
    }

    LOG_INF("Display sample for %s", display_dev->name);

    display_set_pixel_format(display_dev, PIXEL_FORMAT_RGB_888);

    display_get_capabilities(display_dev, &capabilities);

    LOG_INF("capabilities.screen_info: %d", capabilities.screen_info);
    LOG_INF("capabilities.current_pixel_format: %d", capabilities.current_pixel_format);
    LOG_INF("capabilities.supported_pixel_formats: %d", capabilities.supported_pixel_formats);
    LOG_INF("capabilities.x_resolution: %d", capabilities.x_resolution);
    LOG_INF("capabilities.y_resolution: %d", capabilities.y_resolution);

    display_mode = DISPLAY_MODE_OFF;

    // int ret = display_set_orientation(display_dev, DISPLAY_ORIENTATION_ROTATED_180);
    // if (ret != 0) {
    //     LOG_ERR("Faield to set display orientation: %d", ret);
    // }

    int ret = display_blanking_off(display_dev);
    if (ret != 0) {
        return ret;
    }
    return screen_display_welcome();
}

static int screen_display_image(const uint8_t *buffer)
{
    int ret = 0;

    memcpy(buf, buffer, DISPLAY_SEG_BYTES);
    struct display_buffer_descriptor buf_desc = {
        .buf_size = DISPLAY_SEG_BYTES,
        .pitch = DISPLAY_WIDTH,
        .width = DISPLAY_WIDTH,
        .height = DISPLAY_SEG_HEIGHT
    };

    ret = display_write(display_dev, 0, 0, &buf_desc, buf);
    if (ret) {
        return ret;
    }

    memcpy(buf, buffer + DISPLAY_SEG_BYTES, DISPLAY_SEG_BYTES);

    ret = display_write(display_dev, 0, DISPLAY_SEG_HEIGHT, &buf_desc, buf);
    if (ret) {
        return ret;
    }

    memcpy(buf, buffer + DISPLAY_SEG_BYTES * 2, DISPLAY_SEG_BYTES);

    ret = display_write(display_dev, 0, DISPLAY_SEG_HEIGHT * 2, &buf_desc, buf);
    if (ret) {
        return ret;
    }

    return ret;
}

void screen_display_save_image(const void *buffer)
{
    if (image_buffer != NULL) {
        k_free((void *) image_buffer);
    }
    image_buffer = buffer;
}

void screen_display_save_image_reverse(const void *buffer)
{
    if (reverse_image_buffer != NULL) {
        k_free((void *) reverse_image_buffer);
    }
    reverse_image_buffer = buffer;
}

int screen_display_save_animation_frame(int frame_num, const void *buffer)
{
    LOG_INF("Saving upright frame number: %d", frame_num);
    if (frame_num < 0 || frame_num >= MAX_ANIMATION_FRAMES) {
        LOG_ERR("Tried to save invalid frame number: %d", frame_num);
        k_free((uint8_t *) buffer - 1);
        return 1;
    }

    if (anim_buffers[frame_num] != NULL) {
        // subtract 1 because the first byte contains the frame number
        k_free((void *) (anim_buffers[frame_num] - 1));
    }

    anim_buffers[frame_num] = buffer;

    return 0;
}

int screen_display_save_animation_frame_reverse(int frame_num, const void *buffer)
{
    LOG_INF("Saving reverse frame number: %d", frame_num);
    if (frame_num < 0 || frame_num >= MAX_ANIMATION_FRAMES) {
        LOG_ERR("Tried to save invalid frame number: %d", frame_num);
        k_free((uint8_t *) buffer - 1);
        return 1;
    }

    if (reverse_anim_buffers[frame_num] != NULL) {
        // subtract 1 because the first byte contains the frame number
        k_free((void *) (reverse_anim_buffers[frame_num] - 1));
    }

    reverse_anim_buffers[frame_num] = buffer;

    return 0;
}

int screen_display_set_mode(enum DisplayMode mode)
{
    int ret;

    // if (display_mode == mode) {
    //     return 0;
    // }

    display_mode = mode;

    switch (mode) {
    case DISPLAY_MODE_OFF:
        ret = display_blanking_on(display_dev);
        if (ret) {
            return ret;
        }
        break;
    case DISPLAY_MODE_IMAGE:
        if (display_orientation == ORIENTATION_DOWN) {
            if (reverse_image_buffer == NULL) {
                LOG_ERR("Tried to display reverse image when none received");
                return 1;
            }
            ret = screen_display_image(reverse_image_buffer);
            if (ret) {
                return ret;
            }
        } else {
            if (image_buffer == NULL) {
                LOG_ERR("Tried to display upright image when none received");
                return 1;
            }
            ret = screen_display_image(image_buffer);
            if (ret) {
                return ret;
            }
        }
        // deliberately fall through
    case DISPLAY_MODE_DISTANCE:
        ret = display_blanking_off(display_dev);
        if (ret) {
            return ret;
        }
        break;
    case DISPLAY_MODE_ANIMATION:
        break;
    }

    return 0;
}

int screen_display_set_animation_frame(int frame)
{
    int ret;

    if (display_mode != DISPLAY_MODE_ANIMATION) {
        return 0;
    }

    // if (frame == frame_num) {
    //     return 0;
    // }

    // if (frame_num < 0 || frame_num >= MAX_ANIMATION_FRAMES) {
    //     LOG_ERR("Tried to set invalid frame number: %d", frame_num);
    //     return 1;
    // }

    frame = frame % MAX_ANIMATION_FRAMES;

    if (display_orientation == ORIENTATION_DOWN) {
        if (reverse_anim_buffers[frame] == NULL) {
            LOG_ERR("Tried to display a frame that has not been received yet");
            return 2;
        }

        ret = screen_display_image(reverse_anim_buffers[frame]);
    } else {
        if (anim_buffers[frame] == NULL) {
            LOG_ERR("Tried to display a frame that has not been received yet");
            return 2;
        }

        ret = screen_display_image(anim_buffers[frame]);
    }

    return ret;
}


// static void screen_thread(void *, void *, void *)
// {
//     int ret;
    
//     for (;;) {
//         ret = k_event_wait(&tick_event, 1, true, K_FOREVER);
//         printk("RECEIVED TICK ========================================\n");

//         uint32_t frame_num = tick % MAX_ANIMATION_FRAMES;
//         screen_display_set_animation_frame(frame_num);
//     }
// }

int screen_display_set_orientation(enum Orientation orientation)
{
    int ret;
    if (orientation == ORIENTATION_DOWN) {
        ret = display_set_orientation(display_dev, DISPLAY_ORIENTATION_ROTATED_180);
        if (ret != 0) {
            LOG_ERR("Faield to set display orientation: %d", ret);
            return ret;
        }
        // if (display_mode == DISPLAY_MODE_IMAGE) {
        //     // Display the reverse image
        //     ret = screen_display_image(reverse_image_buffer);
        //     if (ret) {
        //         return ret;
        //     }
        // }
    } else {
        ret = display_set_orientation(display_dev, DISPLAY_ORIENTATION_NORMAL);
        if (ret != 0) {
            LOG_ERR("Faield to set display orientation: %d", ret);
            return ret;
        }
        // if (display_mode == DISPLAY_MODE_IMAGE) {
        //     // Display the right-side up image
        //     ret = screen_display_image(image_buffer);
        //     if (ret) {
        //         return ret;
        //     }
        // }
    }

    display_orientation = orientation;
    // Use this to refresh screen.
    ret = screen_display_set_mode(display_mode);

    return 0;
}

int screen_display_welcome(void)
{
    int ret = 0;

    memcpy(buf, welcome, sizeof(welcome) / 2);

    struct display_buffer_descriptor buf_desc = {
        .buf_size = sizeof(welcome) / 2,
        .pitch = WELCOME_WIDTH,
        .width = WELCOME_WIDTH,
        .height = WELCOME_HEIGHT / 2
    };

    ret = display_write(display_dev, WELCOME_X_POS, WELCOME_Y_POS, &buf_desc, buf);
    if (ret) {
        return ret;
    }

    memcpy(buf, (uint8_t *) welcome + sizeof(welcome) / 2, sizeof(welcome) / 2);

    ret = display_write(display_dev, WELCOME_X_POS, WELCOME_Y_POS + WELCOME_HEIGHT / 2, &buf_desc, buf);

    return ret;
}

int screen_display_distance(float dist)
{
    int ret = 0;
    static char dist_text[32];

    if (display_mode != DISPLAY_MODE_DISTANCE) {
        return 0;
    }

    snprintk(dist_text, 32, "%f", (double) dist);

    ret = screen_display_image((uint8_t *) black);
    if (ret != 0) {
        return ret;
    }
    
    memcpy(buf, distance, sizeof(distance));

    struct display_buffer_descriptor buf_desc = {
        .buf_size = sizeof(distance),
        .pitch = DISTANCE_WIDTH,
        .width = DISTANCE_WIDTH,
        .height = DISTANCE_HEIGHT
    };

    ret = display_write(display_dev, DISTANCE_X_POS, DISTANCE_Y_POS, &buf_desc, buf);
    if (ret != 0) {
        return ret;
    }

    // Calculate distance text images

    int x = TEXT_X_POS;
    buf_desc.buf_size = sizeof(zero);
    buf_desc.pitch = TEXT_WIDTH;
    buf_desc.width = TEXT_WIDTH;
    buf_desc.height = TEXT_HEIGHT;

    for (char *p = dist_text; *p; ++p) {
        switch (*p) {
        case '0':
            memcpy(buf, zero, sizeof(zero));
            ret = display_write(display_dev, x, TEXT_Y_POS, &buf_desc, buf);
            break;
        case '1':
            memcpy(buf, one, sizeof(one));
            ret = display_write(display_dev, x, TEXT_Y_POS, &buf_desc, buf);
            break;
        case '2':
            memcpy(buf, two, sizeof(two));
            ret = display_write(display_dev, x, TEXT_Y_POS, &buf_desc, buf);
            break;
        case '3':
            memcpy(buf, three, sizeof(three));
            ret = display_write(display_dev, x, TEXT_Y_POS, &buf_desc, buf);
            break;
        case '4':
            memcpy(buf, four, sizeof(four));
            ret = display_write(display_dev, x, TEXT_Y_POS, &buf_desc, buf);
            break;
        case '5':
            memcpy(buf, five, sizeof(five));
            ret = display_write(display_dev, x, TEXT_Y_POS, &buf_desc, buf);
            break;
        case '6':
            memcpy(buf, six, sizeof(six));
            ret = display_write(display_dev, x, TEXT_Y_POS, &buf_desc, buf);
            break;
        case '7':
            memcpy(buf, seven, sizeof(seven));
            ret = display_write(display_dev, x, TEXT_Y_POS, &buf_desc, buf);
            break;
        case '8':
            memcpy(buf, eight, sizeof(eight));
            ret = display_write(display_dev, x, TEXT_Y_POS, &buf_desc, buf);
            break;
        case '9':
            memcpy(buf, nine, sizeof(nine));
            ret = display_write(display_dev, x, TEXT_Y_POS, &buf_desc, buf);
            break;
        case '.':
            memcpy(buf, dot, sizeof(dot));
            ret = display_write(display_dev, x, TEXT_Y_POS, &buf_desc, buf);
            break;
        default:
            LOG_ERR("Unexpected character '%c' in distance string", *p);
            break;
        }
        if (ret != 0) {
            return ret;
        }
        x += TEXT_WIDTH;
    }

    return ret;
}
```
