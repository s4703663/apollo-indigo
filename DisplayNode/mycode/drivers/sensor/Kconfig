## DisplayNode/mycode/drivers/sensor/hc_sr04/Kconfig
```kconfig
config HC_SR04
    bool "HC-SR04 Ultrasonic Ranging Module"
    default y
    depends on DT_HAS_ELECFREAKS_HC_SR04_ENABLED
    select GPIO
    help
      Enable HC-SR04 Ultrasonic Ranging Module
```

## DisplayNode/mycode/west.yml
```yaml
# Dependant on the west manifest file for upstream Zephyr.
# Zephyr revision should only point to an official release commit.
#
# Only imports subprojects currently required to minimise cloning time.

manifest:
  defaults:
    remote: zephyrproject-rtos

  remotes:
    - name: zephyrproject-rtos
      url-base: https://github.com/zephyrproject-rtos

  projects:
    - name: zephyr
      remote: zephyrproject-rtos
      revision: v3.6.0
      import:
        name-allowlist:
          # - cmsis
          # - hal_nordic
          # - hal_stm32
          # - mbedtls
          # - mcuboot
          # - mcumgr
          # - segger
          # - tinycbor
          # - tinycrypt
          - hal_espressif

  # self:
  #   path: sXXXXXXXX
  #   west-commands: scripts/west-commands.yml
```
